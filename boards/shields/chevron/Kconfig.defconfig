## boards/shields/chevron/Kconfig.defconfig
```kconfig
if SHIELD_CHEVRON_LEFT

# Name must be less than 16 characters long!
config ZMK_KEYBOARD_NAME
    default "Chevron"

config ZMK_SPLIT_ROLE_CENTRAL
    default y

endif

if SHIELD_CHEVRON_LEFT || SHIELD_CHEVRON_RIGHT

config ZMK_SPLIT
    default y

config ZMK_SPLIT_BLE_CENTRAL_BATTERY_LEVEL_FETCHING
    default y

config ZMK_SPLIT_BLE_CENTRAL_BATTERY_LEVEL_PROXY
    default y

endif
```

## boards/shields/chevron/Kconfig.shield
```kconfig
# No whitespace after the comma or in your part name!
config SHIELD_CHEVRON_LEFT
    def_bool $(shields_list_contains,chevron_left)

# No whitespace after the comma or in your part name!
config SHIELD_CHEVRON_RIGHT
    def_bool $(shields_list_contains,chevron_right)
```
